## config/west.yml
```yaml
manifest:
  remotes:
    - name: zmkfirmware
      url-base: https://github.com/zmkfirmware
    - name: jacobsamlarose
      url-base: https://github.com/jacobsamlarose
  projects:
    - name: zephyr
      remote: jacobsamlarose
      revision: v3.0.0+zmk-fixes
    - name: zmk
      remote: jacobsamlarose
      revision: main
      import: app/west.yml
  self:
    path: config
```
